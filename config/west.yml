## config/west.yml
```yaml
manifest:
  remotes:
    - name: zmkfirmware
      url-base: https://github.com/zmkfirmware
    # dongle_display
    # - name: englmaxi
    #   url-base: https://github.com/englmaxi
    # nice_oled - nice_epaper - dongle_display!view - oled Adapter
    # - name: mctechnology17
    #   url-base: https://github.com/mctechnology17
    - name: ZackTully2000
      url-base: https://github.com/ZackTully2000
  projects:
    - name: zmk
      remote: zmkfirmware
      revision: main
      import: app/west.yml
    # nice_oled - nice_epaper
    - name: zmk-nice-oled
      # remote: mctechnology17
      remote: ZackTully2000
      revision: main
  self:
    path: config
```
